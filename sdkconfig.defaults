## sdkconfig.defaults
```kconfig
# MimiClaw - Common Default Configuration
# Target-specific settings are in sdkconfig.defaults.esp32s3

# Network hostname
CONFIG_LWIP_LOCAL_HOSTNAME="mimiclaw"

# SPIFFS: increase max filename length (default 32 is too short for session files)
CONFIG_SPIFFS_OBJ_NAME_LEN=64
```

## sdkconfig.defaults.esp32
```kconfig
# MimiClaw - ESP32-CAM Target Configuration
CONFIG_IDF_TARGET="esp32"

# Flash 4MB + DIO (typical ESP32-CAM config)
CONFIG_ESPTOOLPY_FLASHSIZE_4MB=y
CONFIG_ESPTOOLPY_FLASHMODE_DIO=y

# CPU 240MHz
CONFIG_ESP_DEFAULT_CPU_FREQ_MHZ_240=y

# PSRAM 4MB (ESP32-CAM uses standard PSRAM, not Octal)
CONFIG_SPIRAM=y
CONFIG_SPIRAM_SPEED_40M=y
CONFIG_SPIRAM_MALLOC_ALWAYSINTERNAL=2048
CONFIG_SPIRAM_MALLOC_RESERVE_INTERNAL=65536
CONFIG_SPIRAM_MEMTEST=n

# WiFi memory optimization
CONFIG_ESP_WIFI_STATIC_RX_BUFFER_NUM=2
CONFIG_ESP_WIFI_DYNAMIC_RX_BUFFER_NUM=4
CONFIG_ESP_WIFI_RX_BA_WIN=2
CONFIG_LWIP_TCPIP_RECVMBOX_SIZE=12

# TLS optimization (ESP32 PSRAM allocation + smaller buffers)
CONFIG_MBEDTLS_EXTERNAL_MEM_ALLOC=y
CONFIG_MBEDTLS_DYNAMIC_FREE_CONFIG_DATA=y
CONFIG_MBEDTLS_SSL_IN_CONTENT_LEN=8192
CONFIG_MBEDTLS_SSL_OUT_CONTENT_LEN=4096

# WebSocket support (must be explicitly enabled on ESP32)
CONFIG_HTTPD_WS_SUPPORT=y

# Custom partition table
CONFIG_PARTITION_TABLE_CUSTOM=y
CONFIG_PARTITION_TABLE_CUSTOM_FILENAME="partitions_esp32cam.csv"

# UART console (ESP32-CAM has no USB JTAG)
CONFIG_ESP_CONSOLE_UART_DEFAULT=y
CONFIG_ESP_CONSOLE_UART_NUM=0
CONFIG_ESP_CONSOLE_UART_BAUDRATE=115200
```

## sdkconfig.defaults.esp32s3
```kconfig
# MimiClaw - ESP32-S3 Target Configuration
CONFIG_IDF_TARGET="esp32s3"

# Flash 16MB + QIO
CONFIG_ESPTOOLPY_FLASHSIZE_16MB=y
CONFIG_ESPTOOLPY_FLASHMODE_QIO=y

# CPU 240MHz
CONFIG_ESP_DEFAULT_CPU_FREQ_MHZ_240=y

# PSRAM 8MB Octal
CONFIG_SPIRAM=y
CONFIG_SPIRAM_MODE_OCT=y
CONFIG_SPIRAM_SPEED_80M=y
CONFIG_SPIRAM_MALLOC_ALWAYSINTERNAL=2048
CONFIG_SPIRAM_MALLOC_RESERVE_INTERNAL=98304
CONFIG_SPIRAM_MEMTEST=n

# WiFi memory optimization
CONFIG_ESP_WIFI_STATIC_RX_BUFFER_NUM=3
CONFIG_ESP_WIFI_DYNAMIC_RX_BUFFER_NUM=6
CONFIG_ESP_WIFI_RX_BA_WIN=3
CONFIG_LWIP_TCPIP_RECVMBOX_SIZE=16

# TLS optimization (PSRAM allocation + small buffers)
CONFIG_MBEDTLS_EXTERNAL_MEM_ALLOC=y
CONFIG_MBEDTLS_DYNAMIC_FREE_CONFIG_DATA=y
CONFIG_MBEDTLS_SSL_IN_CONTENT_LEN=16384
CONFIG_MBEDTLS_SSL_OUT_CONTENT_LEN=4096

# WebSocket support
CONFIG_HTTPD_WS_SUPPORT=y

# Custom partition table
CONFIG_PARTITION_TABLE_CUSTOM=y
CONFIG_PARTITION_TABLE_CUSTOM_FILENAME="partitions.csv"

# Console: UART primary (non-blocking), USB Serial/JTAG secondary
# Prevents device hang when no USB host is connected (issue #60)
CONFIG_ESP_CONSOLE_UART_DEFAULT=y
CONFIG_ESP_CONSOLE_SECONDARY_USB_SERIAL_JTAG=y
```
